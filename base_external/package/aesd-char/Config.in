## base_external/package/aesd-char/Config.in
```kconfig
config BR2_PACKAGE_AESDCHAR
	bool "aesd-char"
	help
	  Includes the scull and misc-modules kernel modules
```

## base_external/package/ldd/Config.in
```kconfig
config BR2_PACKAGE_LDD
	bool "ldd"
    depends on BR2_LINUX_KERNEL
	help
	  Includes the writer executable, finder.sh and tester.sh in the kernel image.
	  Used to understand buildroot external trees and package builds.
comment "example needs a Linux kernel to be built."
	depends on !BR2_LINUX_KERNEL
```
